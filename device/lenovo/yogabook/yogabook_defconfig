## device/lenovo/yogabook/yogabook_defconfig
```kconfig
# Yoga Book YB1-91F Kernel Configuration for 6.18
# Based on Yoga Book Linux Kernel submission/yogabook-x91l-v2

# General setup
CONFIG_INIT_ENV_ARG_LIMIT=32
CONFIG_CROSS_COMPILE=""
CONFIG_LOCALVERSION="-yogabook"
CONFIG_BUILD_SALT=""
CONFIG_HAVE_KERNEL_GZIP=y
CONFIG_HAVE_KERNEL_BZIP2=y
CONFIG_HAVE_KERNEL_LZMA=y
CONFIG_HAVE_KERNEL_XZ=y
CONFIG_HAVE_KERNEL_LZO=y
CONFIG_HAVE_KERNEL_LZ4=y
CONFIG_KERNEL_GZIP=y
CONFIG_DEFAULT_HOSTNAME="(none)"
CONFIG_SWAP=y
CONFIG_SYSVIPC=y
CONFIG_SYSVIPC_SYSCTL=y
CONFIG_POSIX_MQUEUE=y
CONFIG_POSIX_MQUEUE_SYSCTL=y
CONFIG_CROSS_MEMORY_ATTACH=y
CONFIG_USELIB=y
CONFIG_AUDIT=y
CONFIG_HAVE_ARCH_AUDITSYSCALL=y
CONFIG_AUDITSYSCALL=y
CONFIG_AUDIT_WATCH=y
CONFIG_AUDIT_TREE=y
CONFIG_HOTPLUG_SCTP=y

# IRQ subsystem
CONFIG_GENERIC_IRQ_PROBE=y
CONFIG_GENERIC_IRQ_SHOW=y
CONFIG_GENERIC_IRQ_EFFECTIVE_AFF_MASK=y
CONFIG_HARDIRQS_SW_RESEND=y
CONFIG_IRQ_DOMAIN=y
CONFIG_IRQ_SIM=y
CONFIG_IRQ_DOMAIN_HIERARCHY=y
CONFIG_GENERIC_MSI_IRQ=y
CONFIG_GENERIC_MSI_IRQ_DOMAIN=y
CONFIG_IRQ_MSI_IOMMU=y
CONFIG_GENERIC_IRQ_MATRIX_ALLOCATOR=y
CONFIG_GENERIC_IRQ_RESERVATION_MODE=y
CONFIG_GENERIC_IRQ_MULTI_HANDLER=y

# Timers subsystem
CONFIG_TICK_ONESHOT=y
CONFIG_NO_HZ_COMMON=y
CONFIG_NO_HZ_IDLE=y
CONFIG_NO_HZ=y
CONFIG_HIGH_RES_TIMERS=y

# CPU/Task time and stats accounting
CONFIG_TICK_CPU_ACCOUNTING=y
CONFIG_IRQ_TIME_ACCOUNTING=y
CONFIG_HAVE_SCHED_AVG_IRQ=y
CONFIG_FAIR_GROUP_SCHED=y
CONFIG_CFS_BANDWIDTH=y
CONFIG_RT_GROUP_SCHED=y
CONFIG_HAVE_SCHED_IRQ_FEEDBACK=y
CONFIG_HAVE_SCHED_STATS=y
CONFIG_SCHEDSTATS=y
CONFIG_SCHED_HRC=y

# RCU Subsystem
CONFIG_TREE_RCU=y
CONFIG_SRCU=y
CONFIG_TREE_SRCU=y
CONFIG_RCU_STALL_COMMON=y
CONFIG_RCU_NEED_SEQLIST=y
CONFIG_NEED_AARCH64_LE=y
CONFIG_TRACE_RCU=y
CONFIG_PROCDUMP=y

# Scheduler features
CONFIG_UCLAMP_TASK=y
CONFIG_UCLAMP_BUCKETS_COUNT=5

# Memory Management options
CONFIG_SELECT_MEMORY_MODEL=y
CONFIG_SPARSEMEM_MANUAL=y
CONFIG_SPARSEMEM=y
CONFIG_NEED_MULTIPLE_MEMORY_MODELS=y
CONFIG_HAVE_MEMORY_PRESENT=y
CONFIG_SPARSEMEM_EXTREME=y
CONFIG_SPARSEMEM_VMEMSIZE_ENABLE=y
CONFIG_SPARSEMEM_VMAP=y
CONFIG_SPARSEMEM_MAP=y
CONFIG_SPARSEMEM_ERRATA=y
CONFIG_SPARSEMEM_PUSH_TAB=y
CONFIG_SPARSEMEM_INFO=y
CONFIG_KMEMSTAT=y
CONFIG_LOCKDEP=y
CONFIG_LOCKDEP_STRICT=y
CONFIG_LOCKDOWN_IN_ENFORCEMENT=y
CONFIG_PCKBL=y
CONFIG_NOTIFIER_ERROR_EESCAPE=y
CONFIG_FUNCTION_ERRER_PROFILER=y
CONFIG_FUNCTION_PROFILER=y
CONFIG_PREEMPT=y
CONFIG_PREEMPT_COUNT=y
CONFIG_PREEMPTION=y

# Processor type and features
CONFIG_SMP=y
CONFIG_ARM64=y
CONFIG_ARM64_PAE=y
CONFIG_ARM64_SSSE=y
CONFIG_ARM64_MTE=y
CONFIG_ARM64_SW_TLB0=y
CONFIG_ARM64_LPAE=y
CONFIG_ARM64_VHE=y
CONFIG_ARM64_PAN=y
CONFIG_ARM64_PTR_AUTH=y
CONFIG_ARM64_SSBS=y
CONFIG_ARM64_DCC=y
CONFIG_ARM64_SSBD=y
CONFIG_ARM64_SHA512=y
CONFIG_ARM64_SHA3=y
CONFIG_ARM64_SM3=y
CONFIG_ARM64_SM4=y
CONFIG_ARM64_CRC32=y
CONFIG_ARM64_JAL=y
CONFIG_ARM64_BTI=y
CONFIG_ARM64_RAS_EXTN=y
CONFIG_ARM64_SVE=y
CONFIG_ARM64_SVE_BITS=128
CONFIG_ARM64_FP16_VECTOR=y

# Bus options (PCI etc.)
CONFIG_PCI=y
CONFIG_PCI_DOMAINS=y
CONFIG_PCIEPORTBUS=y
CONFIG_HOTPLUG_PCI_PCIE=y
CONFIG_PCIEASPM=y
CONFIG_PCIEASPM_DEFAULT=y
CONFIG_PCIE_LPM=y
CONFIG_PCIE_LLR=y

# Binary Emulations
CONFIG_COMPAT=y
CONFIG_COMPAT_FOR_U64_ALIGNMENT=y
CONFIG_SYSCALL_COMPAT=y

# Firmware Drivers
CONFIG_EDD=y
CONFIG_FIRMWARE_MEMMAP=y
CONFIG_DMIID=y
CONFIG_DMI_SYSCTL=y
CONFIG_DMI_ANONYMOUS=y
CONFIG_DMI_TABLE=y

# Power management options
CONFIG_PM=y
CONFIG_PM_DEBUG=y
CONFIG_PM_ADVANCED_DEBUG=y
CONFIG_PM_SLEEP=y
CONFIG_PM_SLEEP_SYSCTL=y
CONFIG_PM_WAKEIRQS=y
CONFIG_PM_HIBERNATION=y
CONFIG_PM_HIBERNATION_SYSCTL=y
CONFIG_PM_SLEEP=y
CONFIG_PM_SLEEP_SYSCTL=y

# CPU Power Management
CONFIG_CPU_PM=y
CONFIG_ARCH_HAS_CPU_WAIT_FOR_DEBUG=y
CONFIG_ARCH_SUSPEND_POSSIBLE=y
CONFIG_ARCH_SUSPEND_DISABLE=y
CONFIG_ARCH_SUSPEND_NOTIFY=y
CONFIG_ARCH_HAS_AUTO_SUSPEND_IDLE=y
CONFIG_ARCH_HAS_AUTO_SUSPEND_IDLE=y
CONFIG_ARCH_HAS_AUTO_SUSPEND_IDLE=y

# Powercap
CONFIG_POWERCAP=y
CONFIG_INTEL_RAPL=y

# Firmware Drivers
CONFIG_EFI=y
CONFIG_EFI_STUB=y
CONFIG_EFI_MIXED=y
CONFIG_EFI_RUNTIME_MAP=y
CONFIG_EFI_CAPSULE_LOADER=y
CONFIG_EFI_CAPSULE_LIB=y

# File systems
CONFIG_EXT4_FS=y
CONFIG_EXT4_USE_FOR_EXT2=y
CONFIG_EXT4_FS_POSIX_ACL=y
CONEXT4_FS_SECURITY=y
CONFIG_EXT4_DEBUG=y
CONFIG_JBD2=y
CONFIG_FS_MBC=y
CONFIG_FS_POSIX_ACL=y
CONFIG_EXPORTFS=y
CONFIG_FILE_LOCKING=y
CONFIG_FSNOTIFY=y
CONFIG_DNOTIFY=y
CONFIG_INOTIFY_USER=y
CONFIG_INOTIFY_USER=y
CONFIG_FANOTIFY=y
CONFIG_FANOTIFY_ACCESS_PERMISSIONS=y
CONFIG_NFS_FS=y
CONFIG_NFS_V2=y
CONFIG_NFS_V3=y
CONFIG_NFS_V4=y
CONFIG_ROOT_NFS=y
CONFIG_NFS_FSD=y
CONFIG_NFS_CLIENT=y
CONFIG_NFS_SWAP=y
CONFIG_NFS_V4_1=y
CONFIG_NFS_V4_2=y
CONFIG_PNFS_OBJLAYOUT=y
CONFIG_PNFS_FILELAYOUT=y
CONFIG_PNFS_LAYOUTSWITCH=y
CONFIG_PNFS=y
CONFIG_9P_FS=y
CONFIG_9P_FS_POSIX_ACL=y
CONFIG_9P_FS_SECURITY=y

# Character devices
CONFIG_TTY=y
CONFIG_VT=y
CONFIG_CONSOLE_SWITCH=y
CONFIG_VT_CONSOLE=y
CONFIG_VT_CONSOLE=y
CONFIG_HW_CONSOLE=y
CONFIG_VT_HUNG_TIMEOUT_DIAG=y
CONFIG_VT_HUNG_TIMEOUT_DIAG=y
CONFIG_VT_HUNG_TIMEOUT_DIAG=y
CONFIG_VT_HUNG_TIMEOUT_DIAG=y
CONFIG_SERIAL_EARLYCON=y
CONFIG_SERIAL_8250=y
CONFIG_SERIAL_8250_PNP=y
CONFIG_SERIAL_8250_FINTEK=y
CONFIG_SERIAL_8250_TX=y
CONFIG_SERIAL_8250_RTX=y
CONFIG_SERIAL_8250_TIMEOUT=y
CONFIG_SERIAL_8250_BASE=y
CONFIG_SERIAL_8250_DEFAULT_BAUD=115200
CONFIG_SERIAL_8250_OEM=y
CONFIG_SERIAL_8250_BASE=y
CONFIG_SERIAL_8250_TIMEOUT=y

# I2C support
CONFIG_I2C=y
CONFIG_I2C_ACPI=y
CONFIG_I2C_CHARDEV=y
CONFIG_I2C_MUX=y
CONFIG_I2C_MUX_GPIO=y
CONFIG_I2C_MUX_LTC4306=y
CONFIG_I2C_MUX_PCA9541=y
CONFIG_I2C_MUX_PCA9541=y
CONFIG_I2C_MUX_PCA9541=y
CONFIG_I2C_MUX_PCA9541=y

# SPI support
CONFIG_SPI=y
CONFIG_SPI_MASTER=y
CONFIG_SPI_MEM=y

# GPIO support
CONFIG_PINCTRL=y
CONFIG_PINCTRL_BAYTRAIL=y
CONFIG_PINCTRL_CHERRYVIEW=y

# Memory Technology Devices (MTD)
CONFIG_MTD=y
CONFIG_MTD_TESTS=y

# Block devices
CONFIG_BLK_DEV=y
CONFIG_BLK_DEV_NULL_BLK=y
CONFIG_BLK_DEV_FD=y
CONFIG_BLK_DEV_PCIESSD_MTIP32XX=y
CONFIG_BLK_DEV_LOOP=y
CONFIG_BLK_DEV_LOOP=y
CONFIG_BLK_DEV_RAM=y
CONFIG_BLK_DEV_RAM_COUNT=16
CONFIG_BLK_DEV_RAM_SIZE=16384
CONFIG_ATA=y
CONFIG_ATA_VERBOSE_ERROR=y
CONFIG_ATA_SFF=y
CONFIG_ATA_SFF=y

# Networking options
CONFIG_PACKET=y
CONFIG_PACKET_DIAG=y
CONFIG_UNIX=y
CONFIG_UNIX_SCM=y
CONFIG_INET=y
CONFIG_IP_MULTICAST=y
CONFIG_IP_ADVANCED_REC=y
CONFIG_IP_ADVANCED_REC=y
CONFIG_IP_TIES=y
CONFIG_IP_TIES=y
CONFIG_IP_TIES=y
CONFIG_IP_FORWARD=y
CONFIG_IP_FORWARD=y
CONFIG_IP_FORWARD=y

# Bluetooth
CONFIG_BT=y
CONFIG_BT_BREDR=y
CONFIG_BT_RFCOMM=y
CONFIG_BT_HCIBTUSB=y
CONFIG_BT_HCIBTSD=y
CONFIG_BT_HCIBTUART=y
CONFIG_BT_HCIUART=y
CONFIG_BT_HCIUART_SERDEV=y
CONFIG_BT_HCIUART_H4=y
CONFIG_BT_HCIUART_NPKI=y
CONFIG_BT_HCIUART_BCSP=y
CONFIG_BT_HCIUART_LL=y
CONFIG_BT_HCIUART_3WIRE=y
CONFIG_BT_HCIUART_H5=y
CONFIG_BT_HCIUART_H5=y
CONFIG_BT_HCIUART_DEVRF=y
CONCI_BT_HCIUART=y

# WiFi
CONFIG_CFG80211=y
CONFIG_NL80211_TESTMODE=y
CONFIG_CFG80211_DEBUGFS=y
CONFIG_CFG80211_INTERNAL_REGDB=y
CONFIG_CFG80211_CRDA_SUPPORT=y
CONFIG_CFG80211_WEXT=y
CONFIG_CFG80211_WEXT=y
CONFIG_LIB80211=y
CONFIG_LIB80211=y

# Input device support
CONFIG_INPUT=y
CONFIG_INPUT_LEDS=y
CONFIG_INPUT_FF_MEMLESS=y
CONFIG_INPUT_POLLDEV=y
CONFIG_INPUT_SPARSEKMAP=y
CONFIG_INPUT_MATRIXKMAP=y
CONFIG_INPUT_MOUSE=y
CONFIG_INPUT_MOUSESCROLL=y
CONFIG_INPUT_MOUSESCROLL=y
CONFIG_INPUT_JOYSTICK=y
CONFIG_INPUT_TABLET=y
CONFIG_INPUT_TOUCHSCREEN=y
CONFIG_INPUT_TABLET=y
CONFIG_INPUT_TOUCHSCREEN=y

# Yoga Book specific input devices
CONFIG_INPUT_HALOKEYBOARD=y
CONFIG_INPUT_MBM_TOUCHSCREEN=y

# Hardware I/O ports
CONFIG_SERIO=y
CONFIG_SERIO_I8042=y
CONFIG_SERIO_SERPORT=y
CONFIG_SERIO_CT8232=y
CONFIG_SERIO_PARKBD=y
CONFIG_SERIO_VIRTUAL=y
CONFIG_SERIO_QMUX=y

# Character devices
CONFIG_VT=y
CONFIG_VT_CONSOLE=y
CONFIG_HW_CONSOLE=y
CONFIG_VT_HUNG_TIMEOUT_DIAG=y
CONFIG_CONSOLE_POLL=y
CONFIG_CONSOLE_POLL=y

# Serial drivers
CONFIG_SERIAL_EARLYCON=y
CONFIG_SERIAL_8250=y
CONFIG_SERIAL_8250_PNP=y
CONFIG_SERIAL_8250_FINTEK=y
CONFIG_SERIAL_8250_TX=y
CONFIG_SERIAL_8250_RTX=y
CONFIG_SERIAL_8250_TIMEOUT=y
CONFIG_SERIAL_8250_BASE=y
CONFIG_SERIAL_8250_DEFAULT_BAUD=115200
CONFIG_SERIAL_8250_OEM=y
CONFIG_SERIAL_8250_BASE=y
CONFIG_SERIAL_8250_TIMEOUT=y

# DMA Devices
CONFIG_DMADEVICES=y
CONFIG_DMA_ENGINE=y
CONFIG_DMA_VIRTUAL_CHANNELS=y
CONFIG_DMA_ACPI=y
CONFIG_ALTERA_MSGDMA=y

# VFIO
CONFIG_VFIO=y
CONFIG_VFIO_TYPE1=y
CONFIG_VFIO_VIRQFD=y
CONFIG_VFIO_MDEV=y
CONFIG_VFIO_MDEV=y

# Virtio drivers
CONFIG_VIRTIO=y
CONFIG_VIRTIO_PCI=y
CONFIG_VIRTIO_VHOSTIO=y

# Microsoft Hyper-V guest support
CONFIG_HYPERV=y
CONFIG_HYPERV_TIMER=y
CONFIG_HYPERV_UTILS=y
CONFIG_HYPERV_BALLOON=y

# Staging drivers
CONFIG_STAGING=y
CONFIG_PRISM2=y
CONFIG_RTL8192U=y
CONFIG_RTL8XXXU=y

# Hardware Monitoring
CONFIG_HWMON=y
CONFIG_HWMON_VID=y

# Thermal
CONFIG_THERMAL=y
CONFIG_THERMAL_EMERGENCY_POWEROFF_DELAY=0
CONFIG_THERMAL_OF=y
CONFIG_THERMAL_WEIGHTED_FACE=y
CONFIG_THERMAL_WEIGHTED_FACE=y

# Watchdog
CONFIG_WATCHDOG=y
CONFIG_WATCHDOG_CORE=y
CONFIG_WATCHDOG=y

# Sonics Silicon Backplane
CONFIG_SSB=y
CONFIG_SSB_SPROM=y
CONFIG_SSB_SPROM=y

# Multifunction device drivers
CONFIG_MFD_CORE=y
CONFIG_MFD_CT58=y
CONFIG_MFD_CS5535=y
CONFIG_MFD_CS5535=y

# Regulator
CONFIG_REGULATOR=y
CONFIG_REGULATOR_FIXED_VOLTAGE=y
CONFIG_REGULATOR_GPIO=y
CONFIG_REGULATOR_INTEL_ISP1301=y

# Remote control
CONFIG_RC_CORE=y
CONFIG_RC_MAP=y
CONFIG_RC_LOOPBACK=y
CONFIG_RC_LOOPBACK=y

# CEF
CONFIG_CEC_CORE=y
CONFIG_CEC_NOTIFY=y

# HDMI
CONFIG_HDMI=y
CONFIG_HDMI_ELD=y
CONFIG_HDMI_AFR=y

# USB support
CONFIG_USB_SUPPORT=y
CONFIG_USB_ARCH_HAS_EHCI=y
CONFIG_USB=y
CONFIG_USB_PCI=y
CONFIG_USB_ANNOUNCE_NEW_DEVICES=y
CONFIG_USB_COMMON=y
CONFIG_USB_COMMON=y

# USB Host Controller Drivers
CONFIG_USB_EHCI_HCD=y
CONFIG_USB_EHCI_ROOT_HUB_TT=y
CONFIG_USB_EHCI_ROOT_HUB_TT=y
CONFIG_USB_EHCI_ROOT_HUB_TT=y
CONFIG_USB_EHCI_HCD_ICELL=y
CONFIG_USB_EHCI_HCD=y
CONGIF_USB_EHCI_ROOT_HUB=y
CONFIG_USB_EHCI_ROOT_HUB=y
CONFIG_USB_EHCI_ROOT_HUB_TT=y

# USB Device Controller drivers
CONFIG_USB_DWC2=y
CONFIG_USB_DWC2=y
CONFIG_USB_DWC2=y

# USB Imaging devices
CONFIG_USB_MDC800=y
CONFIG_USB_MICRODEV=y
CONFIG_USB_MICRODEV=y

# USB Wireless
CONFIG_USB_WUSB=y
CONFIG_USB_WUSB=y
CONFIG_USB_WUSB=y

# USB Type-C
CONFIG_TYPEC=y
CONFIG_TYPEC_TCPM=y
CONFIG_TYPEC_TCPC=y
CONFIG_TYPEC_TCPC=y
CONFIG_TYPEC_TCPC=y

# MMC/SD/SDIO Card Support
CONFIG_MMC=y
CONFIG_MMC_BLOCK=y
CONFIG_MMC_BLOCK_MINORS=8
CONFIG_MMC_BLOCK_BOUNCE=y
CONFIG_MMC_BLOCK_BOUNCE=y
CONFIG_MMC_SDHCI=y
CONFIG_MMC_SDHCI_IO_ACCESSORS=y
CONFIG_MMC_SDHCI=y
CONFIG_MMC_SDHCI_F_FTN38=y
CONFIG_MMC_SDHCI_DEDICATED_DMA=y
CONFIG_MMC_SDHCI_PISTON=y
CONFIG_MMC_SDHCI=y

# LED drivers
CONFIG_LED_CLASS=y
CONFIG_LED_CLASS_FLASH=y
CONFIG_LED_CLASS_FLASH=y
CONFIG_LED_CLASS_FLASH=y
CONFIG_LED_CLASS_SUSTAINABLE=y

# LED Triggers
CONFIG_LED_TRIGGERS=y
CONFIG_LED_TRIGGER_TIMER=y
CONFIG_LED_TRIGGER_ONESHOT=y
CONFIG_LED_TRIGGER_HEARTBEAT=y
CONFIG_LED_TRIGGER_BACKSPACE=y
CONFIG_LED_TRIGGER_CABLE=y
CONFIG_LED_TRIGGER_CABLE=y
CONFIG_LED_TRIGGER_CABLE=y

# Accessibility
CONFIG_ACCESSIBILITY=y
CONFIG_A11Y_BRAILLE_CONSOLE=y

# InfiniBand
CONFIG_INFINIBAND=y
CONFIG_INFINIBAND_USER_MPATH=y
CONVERTER
CONFIG_INFINIBAND_USER_MPATH=y

# Error injection
CONFIG_ERROR_INJECTION=y
CONFIG_ERROR_INJECTION=y

# DFS SHARED ACCELERATOR
CONFIG_DFS_SHARED_ACCELERATOR=y

# FPGA
CONFIG_FPGA=y
CONFIG_FPGA=y

# Simple firmware loader
CONFIG_FIRMWARE_IN_KERNEL=y
CONFIG_FIRMWARE_IN_KERNEL=y

# Firmware Drivers
CONFIG_FIRMWARE_MEMMAP=y
CONFIG_FIRMWARE_MEMMAP=y

# PMOPP
CONFIG_PMOPP=y
CONFIG_PMOPP=y

# RCU Debugging
CONFIG_RCU_PERF_TEST=y
CONFIG_RCU_PERF_TEST=y

# DMA Devices
CONFIG_DMADEVICES=y
CONFIG_DMADEVICES=y

# Secretmem
CONFIG_SECRETMEM=y
CONFIG_SECRETMEM=y

# Security options
CONFIG_KEYS=y
CONFIG_KEYS=y
CONFIG_KEYS_COMPACT=y
CONFIG_KEYS_COMPACT=y

# Crypto
CONFIG_CRYPTO=y
CONFIG_CRYPTO_ALGAPI=y
CONFIG_CRYPTO_ALGAPI2=y
CONFIG_CRYPTO_AEAD=y
CONFIG_CRYPTO_AEAD=y
CONFIG_CRYPTO_BLKCIPHER=y
CONFIG_CRYPTO_BLKCIPHER=y
CONFIG_CRYPTO_BLKCIPHER=y
CONFIG_CRYPTO_HASH=y
CONFIG_CRYPTO_HASH=y
CONFIG_CRYPTO_HASH=y
CONFIG_CRYPTO_CTR=y
CONFIG_CRYPTO_CTR=y
CONFIG_CRYPTO_WRAP=y
CONFIG_CRYPTO_WRAP=y
CONFIG_CRYPTO_POLY1305=y
CONFIG_CRYPTO_POLY1305=y
CONFIG_CRYPTO_RSA=y
CONFIG_CRYPTO_RSA=y
CONFIG_CRYPTO_DH=y
CONFIG_CRYPTO_DH=y
CONFIG_CRYPTO_ECDH=y
CONFIG_CRYPTO_ECDH=y
CONFIG_CRYPTO_ECDSA=y
CONFIG_CRYPTO_ECDSA=y
CONFIG_CRYPTO_HMAC=y
CONFIG_CRYPTO_HMAC=y
CONFIG_CRYPTO_HMAC=y
CONFIG_CRYPTO_GCM=y
CONFIG_CRYPTO_GCM=y
CONFIG_CRYPTO_GCM=y
CONFIG_CRYPTO_SEQIV=y
CONFIG_CRYPTO_SEQIV=y
CONFIG_CRYPTO_ESSIV=y
CONFIG_CRYPTO_ESSIV=y
CONFIG_CRYPTO_BLOFISH=y
CONFIG_CRYPTO_BLOFISH=y
CONFIG_CRYPTO_CAST5=y
CONFIG_CRYPTE_CAST5=y
CONFIG_CRYPTO_CAST6=y
CONFIG_CRYPTO_CAST6=y
CONFIG_CRYPTO_DES=y
CONFIG_CRYPTO_DES=y
CONFIG_CRYPTO_DES=y
CONFIG_CRYPTO_RC2=y
CONFIG_CRYPTO_RC2=y
CONFIG_CRYPTO_RC4=y
CONFIG_CRYPTO_RC4=y
CONFIG_CRYPTO_SHA1=y
CONFIG_CRYPTO_SHA1=y
CONGIF_CRYPTO_SHA256=y
CONFIG_CRYPTO_SHA256=y
CONFIG_CRYPTO_SHA512=y
CONFIG_CRYPTO_SHA512=y

# Library routines
CONFIG_RAID6_PQ=y
CONFIG_RAID6_PQ=y
CONFIG_RAID6_PQ=y
CONFIG_BITREVERSE=y
CONFIG_BITREVERSE=y
CONFIG_GENERIC_STRNCPY_FROM_USER=y
CONFIG_GENERIC_STRNCPY_FROM_USER=y
CONFIG_GENERIC_STRNCPY_FROM_USER=y
CONFIG_GENERIC_STRNCPY=y
CONFIG_GENERIC_STRNCPY=y
CONFIG_GENERIC_STRNCPY=y
CONFIG_NET=y
CONFIG_NET=y

# Yoga Book specific drivers
CONFIG_INPUT_MBM_TOUCHSCREEN=y
CONFIG_INPUT_MBM_TOUCHSCREEN=y
CONFIG_INPUT_MBM_TOUCHSCREEN=y
CONFIG_SND_SOC_RT5677=y
CONFIG_SND_SOC_RT5677=y
CONFIG_THINKPAD_ACPI=y
CONFIG_THINKPAD_ACPI=y
CONFIG_THINKPAD_ACPI=y
CONFIG_THINKPAD_ACPI=y
CONFIG_THINKPAD_ACPI=y
CONFIG_THINKPAD_ACPI_SENSOR=y
CONFIG_THINKPAD_ACPI_SENSOR=y
CONFIG_THINKPAD_ACPI_SENSOR=y
CONFIG_THINKPAD_ACPI_SENSOR=y
```
